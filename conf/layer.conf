## conf/layer.conf
```bitbake
# We have a conf and classes directory, add to BBPATH
BBPATH .= ":${LAYERDIR}"

# We have recipes-* directories, add to BBFILES
BBFILES += "${LAYERDIR}/recipes-*/*/*.bb \
	${LAYERDIR}/recipes-*/*/*.bbappend"

BBFILE_COLLECTIONS += "gdpd_layer"
BBFILE_PATTERN_gdpd_layer = "^${LAYERDIR}/"
BBFILE_PRIORITY_gdpd_layer = "6"
```
